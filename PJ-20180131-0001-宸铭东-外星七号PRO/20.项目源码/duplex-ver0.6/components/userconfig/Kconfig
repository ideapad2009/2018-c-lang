## PJ-20180131-0001-宸铭东-外星七号PRO/20.项目源码/duplex-ver0.6/components/userconfig/Kconfig
```kconfig
menu "ESP Audio App"

config ENABLE_OTA_SERVICE
    bool "Enable the OTA service"
    default n
    help
        Enable ota service, it will need wifi enable.

config ENABLE_DLNA_SERVICE
    bool "Enable the DLNA service"
    default y
    help
        Enable DLNA service.

config ENABLE_RECOGNITION_SERVICE
    bool "Enable the recognition service"
    default n
    help
        Enable recognition service.

config ENABLE_TURINGAIWIFI_SERVICE
    bool "Enable the turingaiwifi service"
    default n
    help
        Enable turingaiwifi service.

config ENABLE_TURINGWECHAT_SERVICE
    bool "Enable the turingwechat service"
    default n
    help
        Enable turingwechat service.

config ENABLE_SMART_CONFIG
    bool "Enable the smart config method"
    default n
    help
        Enable smart config.


config ENABLE_BLE_CONFIG
    bool "Enable the ble config method"
    default n
    help
        Enable ble config.
        
config ESP_AUDIO_WIFI_SSID
    string "WI-FI SSID"
    default "Your SSID"
    help
        Add WIFI SSID.
config ESP_AUDIO_WIFI_PWD
    string "WI-FI password"
    default "Your password"
    help
        Add WIFI password.

endmenu
```
